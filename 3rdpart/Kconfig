## 3rdpart/Kconfig
```kconfig
comment "The third party libraries"
	config ZLOG
	bool "builtin zlog library"
	default n
if ZLOG
	comment "zlog configure file parameters"

	config LOG_DIR
	string "log file path"
	default "/tmp/tools.log"

	config LOG_FILESIZE
	string "log file size default: 20MB"
	default "20MB"

	config LOG_ROTATE
	string "log file retate default: 5"
	default "5"
endif
```

## Config.in
```kconfig
mainmenu "Configuration"

config  DEBUG
bool    "Debug tool, Be related to print debug"
default  y
help

config  FILE
bool    "File tool, Be related to file"
default  y
help

config  SEMAPHORE
bool    "Semaphore tool, Be related to system V sem function"
default  y
help

config	SHAREMEM
bool    "Share memory tool, Be related to system V share memory function"
default  y
help

config  THREADPOOL
bool    "Thread pool tool, Be related to thread pool"
default  y
help

config  SERIAL
bool    "serial port tool, Be related to serial port"
default  y
help
```

## Kconfig
```kconfig
mainmenu "Configuration"

config ARCH
	bool "CPU ARCH"
	default y
choice
	prompt "Select ARCH"
	depends on ARCH
	default X86

	config X86
	bool "CPU ARCH X86"

	config ARM
	bool "CPU ARCH ARM"

	config ARM64
	bool "CPU ARCH ARM64"

	config PPC
	bool "CPU ARCH PPC"

	config PPC64
	bool "CPU ARCH PPC64"

	config MIPS64
	bool "CPU ARCH MIPS64"
endchoice

config  DEBUG
bool    "Debug tool, Be related to print debug"
default  y
	config DEBUG_ENV
	bool "Open environment control"
	depends on DEBUG
	default n


config  FILE
bool    "File tool, Be related to file"
default  y

config  SEMAPHORE
bool    "Semaphore tool, Be related to system V sem function"
default  y

config	SHAREMEM
bool    "Share memory tool, Be related to system V share memory function"
default  y

config  THREADPOOL
bool    "Thread pool tool, Be related to thread pool"
default  y
	config THREADPOOL_THREAD_MAX
	int "Thread pool max thread number"
	depends on THREADPOOL
	default 64

config  SERIAL
bool    "Serial port tool, Be related to serial port"
default  y

config  TIMER
bool    "Time tool, Be related to time function"
default  y

config  SIGNAL
bool    "Signal tool, Be related to signal function"
default  y

config	MATCH
bool    "Match algo tool, Be related to match algo function"
default  y

config	HASHMAP
bool    "Hash map"
default  y
select MD5
	config HASHMAP_MD5
	bool "MD5 digest, Use MD5 digest compute hash value "
	depends on HASHMAP
	default y

config RING
bool	"Ring, Lock-free queue ring"
default y

	config RING_DEBUG
	bool "Ring debug, Record the number of success/failure of each thread in and out of the queue"
	depends on RING
	default n

	config CACHE_LINE_SIZE
	int "CPU cache line, Default 64 bytes"
	depends on RING
	default 64

	config RING_PAUSE_REP_COUNT
	int "Yield after pause num of times, no yield if RTE_RING_PAUSE_REP not defined"
	depends on RING
	default 0
```

## scripts/kconfig/Config.in
```kconfig
mainmenu "Configuration"

config  DEBUG
tristate "Debug tool, Be related to print debug"
default 'm'
help

config  FILE
bool    "File tool, Be related to file"
default  y
help

config  SEMAPHORE
bool    "Semaphore tool, Be related to system V sem function"
default  y
help

config	SHAREMEM
bool    "Share memory tool, Be related to system V share memory function"
default  y
help

config  THREADPOOL
bool    "Thread pool tool, Be related to thread pool"
default  y
help

config  SERIAL
bool    "serial port tool, Be related to serial port"
default  y
help

config  TIMER
bool    "time tool, Be related to time function"
default  y
help

config  SIGNAL
bool    "signal tool, Be related to signal function"
default  y
help

config	MATCH
bool    "match algo tool, Be related to match algo function"
default  y
help
```
